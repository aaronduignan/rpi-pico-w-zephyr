## CMakeLists.txt
```
cmake_minimum_required(VERSION 3.20.0)

# WHD requires firmware paths even for GPIO-only use — the blob embedding
# code runs unconditionally when CONFIG_AIROC_WIFI_CUSTOM=y.
get_filename_component(REPO_ROOT "${CMAKE_CURRENT_SOURCE_DIR}/../.." ABSOLUTE)

# Neither firmware produces reliable GPIO behaviour on WL_GPIO0.
# FMAC firmware (43439A0.bin) is theoretically correct — WL_GPIO0 is not
# claimed by the firmware — but cyw43_gpio writes still land erratically.
# BT firmware (wb43439A0_7_95_49_00_bluetooth.bin) is kept below for
# reference; it contends for WL_GPIO0 as a coexistence signal and is worse.
set(FW_IMAGE_NAME    /workspace/modules/hal/infineon/zephyr/blobs/img/whd/resources/firmware/COMPONENT_43439/43439A0.bin)
# set(FW_IMAGE_NAME  ${REPO_ROOT}/firmware/wb43439A0_7_95_49_00_bluetooth.bin)
set(NVRAM_IMAGE_NAME ${REPO_ROOT}/firmware/picow_nvram.txt)
set(CLM_IMAGE_NAME /workspace/modules/hal/infineon/zephyr/blobs/img/whd/resources/clm/COMPONENT_43439/COMPONENT_MURATA-1YN/43439A0.clm_blob)

find_package(Zephyr REQUIRED HINTS $ENV{ZEPHYR_BASE})
project(led_blinky)
target_sources(app PRIVATE src/main.c)

if(DEFINED ENV{HOST_WORKSPACE})
    zephyr_compile_options(
        -fdebug-prefix-map=/workspace=$ENV{HOST_WORKSPACE}/workspace
        -fdebug-prefix-map=/workspace/app=$ENV{HOST_WORKSPACE}
    )
endif()
```

## prj.conf
```kconfig
CONFIG_STDOUT_CONSOLE=y
CONFIG_PRINTK=y
CONFIG_LOG=y
CONFIG_LOG_MODE_IMMEDIATE=y
CONFIG_LOG_BACKEND_UART=y

# WiFi driver must be enabled to initialise the CYW43439 and its GPIO controller.
# We don't connect to a network — the chip just needs to be up for GPIO to work.
#
# CONFIG_AIROC_WIFI_CUSTOM=y tells WHD to embed firmware blobs from paths set
# in CMakeLists.txt (FW_IMAGE_NAME, CLM_IMAGE_NAME, NVRAM_IMAGE_NAME). WHD runs
# this blob embedding unconditionally, so those paths must be set even when only
# the GPIO controller is used and WiFi/BT are never started.
CONFIG_WIFI=y
CONFIG_WIFI_AIROC=y
CONFIG_AIROC_WIFI_CUSTOM=y

CONFIG_NETWORKING=y
CONFIG_NET_L2_ETHERNET=y
CONFIG_NET_L2_WIFI_MGMT=y

CONFIG_GPIO=y
# CONFIG_GPIO_LOG_LEVEL_DBG=y

# The networking stack needs a random number generator for IPv6. Without BT
# (which pulls in mbedTLS and a crypto RNG), nothing satisfies sys_rand_get.
CONFIG_TEST_RANDOM_GENERATOR=y
```

## boards/rpi_pico_rp2040_w.overlay
```dts
/*
 * The Pico W LED is on WL_GPIO0 of the CYW43439, not on the RP2040.
 * The common rpi_pico-led.dtsi explicitly excludes the Pico W, so we
 * define it here using the cyw43_gpio controller from the board DTS.
 */
/ {
	leds {
		compatible = "gpio-leds";
		led0: led_0 {
			gpios = <&cyw43_gpio 0 GPIO_ACTIVE_LOW>;
			label = "LED";
		};
	};

	aliases {
		led0 = &led0;
	};
};
```

## src/main.c
```c
#include <zephyr/kernel.h>
#include <zephyr/drivers/gpio.h>
#include <zephyr/logging/log.h>

LOG_MODULE_REGISTER(led_blinky);

/*
 * The LED is on WL_GPIO0 of the CYW43439, routed through the cyw43-gpio
 * driver. It is exposed as led0 in the board overlay. The WiFi driver must
 * be initialised (via prj.conf) before this GPIO is accessible.
 *
 * The LED is wired between WL_GPIO0 and VCC — active-low (LOW = on).
 * This is declared in the overlay as GPIO_ACTIVE_LOW so set(1) = LED on.
 */
static const struct gpio_dt_spec led = GPIO_DT_SPEC_GET(DT_ALIAS(led0), gpios);

int main(void)
{
	LOG_INF("LED blinky running");

	if (!gpio_is_ready_dt(&led)) {
		LOG_ERR("LED GPIO not ready");
		return -ENODEV;
	}

	int err = gpio_pin_configure_dt(&led, GPIO_OUTPUT_INACTIVE);

	if (err) {
		LOG_ERR("LED configure failed: %d", err);
		return err;
	}

	while (1) {
		int ret = gpio_pin_set_dt(&led, 1);
		LOG_INF("LED ON (err=%d)", ret);
		k_msleep(2000);

		ret = gpio_pin_set_dt(&led, 0);
		LOG_INF("LED OFF (err=%d)", ret);
		k_msleep(2000);
	}

	return 0;
}
```

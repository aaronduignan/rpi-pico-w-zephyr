## CMakeLists.txt
```
cmake_minimum_required(VERSION 3.20.0)

# Shared infrastructure lives at the repo root, two levels above each sample.
get_filename_component(REPO_ROOT "${CMAKE_CURRENT_SOURCE_DIR}/../.." ABSOLUTE)

list(APPEND DTS_ROOT ${REPO_ROOT})
list(APPEND ZEPHYR_EXTRA_MODULES ${REPO_ROOT}/drivers/cyw43/bt)
set(EXTRA_DTC_OVERLAY_FILE ${REPO_ROOT}/boards/rpi_pico_rp2040_w.overlay)

set(FW_IMAGE_NAME    ${REPO_ROOT}/firmware/wb43439A0_7_95_49_00_bluetooth.bin)
set(NVRAM_IMAGE_NAME ${REPO_ROOT}/firmware/picow_nvram.txt)
# CLM blob is west-managed; lives in the west workspace regardless of sample.
set(CLM_IMAGE_NAME /workspace/modules/hal/infineon/zephyr/blobs/img/whd/resources/clm/COMPONENT_43439/COMPONENT_MURATA-1YN/43439A0.clm_blob)

find_package(Zephyr REQUIRED HINTS $ENV{ZEPHYR_BASE})
project(ble_advertiser)
target_sources(app PRIVATE src/main.c)

if(DEFINED ENV{HOST_WORKSPACE})
    zephyr_compile_options(
        -fdebug-prefix-map=/workspace=$ENV{HOST_WORKSPACE}/workspace
        -fdebug-prefix-map=/workspace/app=$ENV{HOST_WORKSPACE}
    )
endif()
```

## prj.conf
```kconfig
CONFIG_STDOUT_CONSOLE=y
CONFIG_PRINTK=y
CONFIG_LOG=y
CONFIG_LOG_PRINTK=n
CONFIG_LOG_MODE_IMMEDIATE=y
CONFIG_LOG_BACKEND_UART=y
CONFIG_SHELL_LOG_BACKEND=n
CONFIG_BT_HCI_DRIVER_LOG_LEVEL_INF=y

CONFIG_SHELL=y
CONFIG_SHELL_BACKEND_SERIAL=y
CONFIG_SHELL_PROMPT_UART="pico:~$ "

CONFIG_WIFI=y
CONFIG_WIFI_AIROC=y
CONFIG_AIROC_WIFI_CUSTOM=y

CONFIG_NETWORKING=y
CONFIG_NET_L2_ETHERNET=y
CONFIG_NET_L2_WIFI_MGMT=y

CONFIG_BT=y
CONFIG_BT_DEVICE_NAME="Pico W"
CONFIG_BT_GATT_CACHING=n
```

## src/main.c
```c
#include <zephyr/kernel.h>
#include <zephyr/bluetooth/bluetooth.h>
#include <zephyr/logging/log.h>

LOG_MODULE_REGISTER(pico_app);

/*
 * Advertising interval — units are 0.625 ms; pick a min/max pair:
 *
 *   FAST_INT_MIN/MAX_1   30– 60 ms   (0x0030–0x0060)  high-rate scan window
 *   FAST_INT_MIN/MAX_2  100–150 ms   (0x00a0–0x00f0)  normal fast discovery
 *   SLOW_INT_MIN/MAX   1000–1200 ms  (0x0640–0x0780)  battery-friendly beacon
 *
 * Custom value: BT_GAP_ADV_INTERVAL_TO_US(n) converts n→µs for reference,
 * or just divide target-ms by 0.625 to get the raw value, e.g. 500 ms = 0x0320.
 *
 * options = 0 → non-connectable, non-scannable (phones see it but can't connect).
 */
static const struct bt_le_adv_param adv_param = BT_LE_ADV_PARAM_INIT(
	0,
	BT_GAP_ADV_SLOW_INT_MIN,   /* 1000 ms */
	BT_GAP_ADV_SLOW_INT_MAX,   /* 1200 ms */
	NULL);

/*
 * Advertisement payload — total budget is 31 bytes across all fields.
 * Each field costs: 1 byte length + 1 byte type + N bytes data.
 *
 * Common field types (from assigned_numbers.h):
 *   BT_DATA_FLAGS             0x01  — always first; required for discoverability
 *   BT_DATA_NAME_COMPLETE     0x09  — full device name string
 *   BT_DATA_NAME_SHORTENED    0x08  — if name is too long to fit
 *   BT_DATA_UUID16_ALL        0x03  — 16-bit service UUIDs (e.g. 0x181A = env sensing)
 *   BT_DATA_SVC_DATA16        0x16  — 16-bit UUID + up to ~25 bytes of payload
 *   BT_DATA_MANUFACTURER_DATA 0xff  — 2-byte company ID + freeform payload
 *
 * BT_DATA_BYTES(type, byte, ...)  — inline literal bytes
 * BT_DATA(type, ptr, len)         — pointer to a buffer (e.g. updated at runtime)
 *
 * Example: manufacturer-specific field with a small sensor payload.
 * Company ID 0xFFFF is the test/unregistered ID — replace with your own
 * Bluetooth SIG allocation if you ever ship a product.
 */
static uint8_t mfr_payload[] = {
	0xff, 0xff,  /* company ID 0xFFFF (test) — little-endian */
	0x00,        /* app-defined version / frame type */
	0xBE,        /* payload byte 0 */
	0xEF,        /* payload byte 1 */
};

static const struct bt_data ad[] = {
	BT_DATA_BYTES(BT_DATA_FLAGS, BT_LE_AD_NO_BREDR),
	BT_DATA(BT_DATA_NAME_COMPLETE, CONFIG_BT_DEVICE_NAME,
		sizeof(CONFIG_BT_DEVICE_NAME) - 1),
	BT_DATA(BT_DATA_MANUFACTURER_DATA, mfr_payload, sizeof(mfr_payload)),
};

int main(void)
{
	int err;

	LOG_INF("Pico W - Zephyr BLE beacon");

	err = bt_enable(NULL);
	if (err) {
		LOG_ERR("bt_enable failed: %d", err);
		return err;
	}

	/*
	 * To update mfr_payload between intervals, write to the array and
	 * call bt_le_adv_update_data(ad, ARRAY_SIZE(ad), NULL, 0).
	 */
	err = bt_le_adv_start(&adv_param, ad, ARRAY_SIZE(ad), NULL, 0);
	if (err) {
		LOG_ERR("Advertising start failed: %d", err);
		return err;
	}

	LOG_INF("Advertising as \"%s\" every ~1 s", CONFIG_BT_DEVICE_NAME);

	return 0;
}
```

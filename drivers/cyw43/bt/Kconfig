## drivers/cyw43/bt/Kconfig
```kconfig
config BT_CYW43_SHARED_BUS_HCI
	bool "CYW43439 BT HCI via shared SPI bus"
	default y
	depends on BT && DT_HAS_INFINEON_CYW43_BT_HCI_SHARED_BUS_ENABLED
	help
	  Bluetooth HCI driver for the CYW43439 on Raspberry Pi Pico W.
	  Communicates via the shared PIO SPI bus alongside the AIROC WiFi driver.
```

## dts/bindings/bluetooth/infineon,cyw43-bt-hci-shared-bus.yaml
```yaml
description: |
  CYW43439 Bluetooth HCI transport for Raspberry Pi Pico W.
  Communicates via the shared PIO SPI bus alongside the WiFi driver.
  The WiFi driver (AIROC) must be initialised first.

compatible: "infineon,cyw43-bt-hci-shared-bus"

include: bt-hci.yaml
```

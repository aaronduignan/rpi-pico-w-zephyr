## CMakeLists.txt
```
cmake_minimum_required(VERSION 3.20.0)

# Add custom DTS binding search path for our CYW43 BT HCI shared-bus binding
list(APPEND DTS_EXTRA_CPPFLAGS -I${CMAKE_CURRENT_SOURCE_DIR}/dts)
# Register our out-of-tree BT HCI driver as a Zephyr module
list(APPEND ZEPHYR_EXTRA_MODULES ${CMAKE_CURRENT_SOURCE_DIR}/drivers/bt)

set(FW_IMAGE_NAME
    ${CMAKE_CURRENT_SOURCE_DIR}/firmware/wb43439A0_7_95_49_00_bluetooth.bin)
set(CLM_IMAGE_NAME
    ${CMAKE_CURRENT_SOURCE_DIR}/../modules/hal/infineon/zephyr/blobs/img/whd/resources/clm/COMPONENT_43439/COMPONENT_MURATA-1YN/43439A0.clm_blob)
set(NVRAM_IMAGE_NAME
    ${CMAKE_CURRENT_SOURCE_DIR}/firmware/picow_nvram.txt)

find_package(Zephyr REQUIRED HINTS $ENV{ZEPHYR_BASE})
project(hello_pico_w)
target_sources(app PRIVATE src/main.c)

if(DEFINED ENV{HOST_WORKSPACE})
    zephyr_compile_options(
        -fdebug-prefix-map=/workspace=$ENV{HOST_WORKSPACE}/workspace
        -fdebug-prefix-map=/workspace/app=$ENV{HOST_WORKSPACE}/app
    )
endif()
```

## prj.conf
```kconfig
CONFIG_STDOUT_CONSOLE=y
CONFIG_PRINTK=y
CONFIG_LOG=y
CONFIG_LOG_PRINTK=n
CONFIG_LOG_MODE_IMMEDIATE=y
CONFIG_LOG_BACKEND_UART=y
CONFIG_SHELL_LOG_BACKEND=n
CONFIG_BT_HCI_DRIVER_LOG_LEVEL_INF=y

CONFIG_SHELL=y
CONFIG_SHELL_BACKEND_SERIAL=y
CONFIG_SHELL_PROMPT_UART="pico:~$ "

CONFIG_WIFI=y
CONFIG_WIFI_AIROC=y
CONFIG_AIROC_WIFI_CUSTOM=y
CONFIG_CYW43439=y

CONFIG_NETWORKING=y
CONFIG_NET_L2_ETHERNET=y
CONFIG_NET_L2_WIFI_MGMT=y

CONFIG_BT=y
CONFIG_BT_DEVICE_NAME="Pico W"
CONFIG_BT_GATT_CACHING=n
```

## boards/rpi_pico_rp2040_w.overlay
```dts
/ {
	chosen {
		zephyr,bt-hci = &cyw43_bt_hci;
	};

	/*
	 * CYW43439 Bluetooth HCI device. Uses a custom shared-bus transport
	 * over the same PIO SPI bus as the AIROC WiFi driver — there is no
	 * dedicated BT UART on the Pico W. The driver in drivers/bt/
	 * implements the Zephyr bt_hci_driver_api over this shared bus.
	 */
	cyw43_bt_hci: cyw43-bt-hci {
		compatible = "infineon,cyw43-bt-hci-shared-bus";
		bt-hci-name = "CYW43 Shared Bus";
		bt-hci-bus = "spi";
		status = "okay";
	};
};
```

## src/main.c
```c
#include <zephyr/kernel.h>
#include <zephyr/bluetooth/bluetooth.h>
#include <zephyr/logging/log.h>

LOG_MODULE_REGISTER(pico_app);

int main(void)
{
	int err;

	LOG_INF("Pico W - Zephyr testing");
	LOG_INF("Initialising Bluetooth...");

	err = bt_enable(NULL);

	if (err) {
		LOG_ERR("bt_enable returned: %d", err);
	} else {
		LOG_INF("bt_enable returned: %d", err);
	}

	/* Zephyr shell runs in its own thread; returning here is safe. */
	return 0;
}
```
